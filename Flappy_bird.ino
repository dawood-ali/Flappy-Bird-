
//enjoy the game :)

#include <UTFTGLUE.h>
int not_gravity=0;//Core graphics
#include <Adafruit_GFX.h>
#include <TouchScreen.h>  //touchscreen library
#include <MCUFRIEND_kbv.h> //touchscreen specific library because it detects
//the kind of shield you are using which is really important


//The following are for fonts which are really important for fancy stuff:
#include <Fonts/FreeSans9pt7b.h>
#include <Fonts/FreeSans12pt7b.h>
#include <Fonts/FreeSerif12pt7b.h>
#include <FreeDefaultFonts.h>


#define LCD_CS A3 //chip select is set to A3
#define LCD_CD A2 //command data goes to A2
#define LCD_WR A1 //writing to LCD is set to A1
#define LCD_RD A0 //lcd reading is set to A0
#define LCD_RST A4 //LCD resetting the screen.
#define button 45

MCUFRIEND_kbv tft{LCD_CS,LCD_CD,LCD_WR,LCD_RD,LCD_RST};
//Now here is a list of colours you might be interested in keeping in mind 

#define BLACK 0x0000
#define WHITE 0xFFFF
#define BLUE 0x001F
#define RED 0xF800
#define GREEN 0x07E0
#define CYAN 0x07FF
#define MAGENTA 0xF81F
#define YELLOW 0xFFE0
uint16_t back= tft.color565(113,197,208);
uint16_t obstacle_color= tft.color565(57,174,28);
int lives=3;
int text_printed_gameover=0;
int text_printed_running=0;
int text_printed_paused=0;
uint16_t color;
//Define PINS FOR RESISTIVE TOUCHSCREEN

#define YP A3 //input in the y
#define XM A2 // input in the x
#define YM 9 //output digital
#define XP 8 //output digital
#define minpressure 11036 
#define maxpressure 1000

int pixel_x=0;
int pixel_y=0;
uint16_t r;
uint16_t g;
uint16_t b;
const int TS_LEFT = 965, TS_RT = 95, TS_TOP = 926, TS_BOT = 107; 
int score=0;

TouchScreen ts=TouchScreen(XP,YP,XM,YM,300);
void font_message(uint16_t x, uint16_t y,uint16_t sizee,const GFXfont *f, const char *msg) {
  tft.setCursor(x,y);
  tft.setFont(f);
  tft.setTextSize(sizee);
  tft.print(msg);
}

enum GAME_STATE 
{MENU=0, RUNNING=1, PAUSED=2, GAME_OVER=4};

int current_state= MENU;
boolean buttonEnabled=true;

const uint16_t flappy[1050] PROGMEM={
0x763A, 0x767B, 0x767A, 0x6639, 0x6639, 0x665A, 0x665B, 0x663A, 0x765B, 0x761A, 0x7619, 0x7E18, 0x7E17, 0x8656, 0x8655, 0x7DF4,   // 0x0010 (16) pixels
0x8635, 0x85F6, 0x8DD9, 0x95BA, 0x9DFA, 0xA5F9, 0x95D6, 0x9E17, 0x9618, 0x7DB7, 0x863A, 0x7E5B, 0x65F8, 0x769A, 0x5DF8, 0x6E7A,   // 0x0020 (32) pixels
0x6E39, 0x7639, 0x7639, 0x6DF9, 0x6E19, 0x6E19, 0x6E39, 0x6E39, 0x6E5A, 0x6E5A, 0x6E3A, 0x6DD9, 0x75D9, 0x7DD9, 0x8E5A, 0x7555,   // 0x0030 (48) pixels
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0x6CF3, 0x42EC, 0x3A09, 0x41E8, 0x49E6, 0x4A05, 0x49C3, 0x49A2, 0x51E4, 0x4A05, 0x3A06, 0x3A89, 0x74D3, 0x9639, 0x85D8, 0x8619,   // 0x0410 (1040) pixels
};



void setup() {
  Serial.begin(9600);
  pinMode(button,INPUT);
  digitalWrite(button,HIGH);
  tft.reset();
  uint16_t ID=tft.readID();
  tft.begin(ID);
  tft.setRotation(1);
  tft.fillScreen(BLACK);
  delay(20);
  tft.setCursor(0,20);
  tft.setTextSize(3);
  tft.setTextColor(WHITE);
  font_message(20,50,3,&FreeSans9pt7b,"Flappy Bird Game");
  for(int i=0; i<5;i++) {
    tft.drawFastHLine(10,70+i,449,RED);
  }
  tft.fillRoundRect(20,90,80,50,10,GREEN);
  tft.setTextSize(2);
  tft.setTextColor(BLACK);
  tft.setCursor(20,130);
  tft.print("Start");
}

boolean cant_touch_this(){
  TSPoint p=ts.getPoint();
  if (p.z>0) {
    return true;
  }
  else {
    return false;
  }
}
boolean detect_collision(int x_obstacle,int ratio,int y_flappy) {
  int ratio_decimal_top= (double(ratio)/double(260))*140;
  int ratio_decimal_bottom= 185-int(ratio_decimal_top);
  //the basic case is where the bird touches the first corners/walls that it faces
  //the bird is located at 50 pixels. his mouth can hit the obstacle if we check for 50+ width of the picture
  if ((x_obstacle<=85) && ((x_obstacle+75)>=85) && (ratio_decimal_top>=(y_flappy-3))) {
    return true;
  }
  else if (x_obstacle<=85 && ((x_obstacle+77)>=85) && ((ratio_decimal_top+75)<=(y_flappy+26))) {
    return true;
  }
  else{
    return false;
  }
}
void drawObstacle(int i, int ratio) {
  float ratio_decimal_top= (double(ratio)/double(260))*140;
  float ratio_decimal_bottom= 185-int(ratio_decimal_top);
  tft.fillRect(i,0,75,int(ratio_decimal_top),obstacle_color);
  tft.drawRect(i-1,0,75+2,int(ratio_decimal_top)+1,BLACK);
  tft.fillRect(i,int(ratio_decimal_top)+75,75,int(ratio_decimal_bottom),obstacle_color);
  tft.drawRect(i-1,int(ratio_decimal_top)+75,75+2,int(ratio_decimal_bottom),BLACK);
  
}

void loop() {
  while(current_state==MENU) {
    TSPoint p= ts.getPoint();
    if (p.z>0) {
     //this took over 4 hours to wrap my head around
      pixel_x = map(p.y,TS_RT,TS_LEFT,480,0);
      pixel_y = map(p.x, TS_TOP, TS_BOT, 0, 320);
    }
  
    if (pixel_x>20 && pixel_x<100 && pixel_y>90 && pixel_y<140) {
      tft.reset();
      uint16_t ID= tft.readID();
      tft.begin(ID);
      tft.setRotation(1);
      current_state=PAUSED;
    }

}
  while(current_state==PAUSED && text_printed_paused==0) {
    tft.reset();
    uint16_t ID= tft.readID();
    tft.begin(ID);
    tft.setRotation(1);
    tft.fillRect(0,0,560,260,back);
    color= tft.color565(r=190,g=190,b=124);
    tft.fillRect(0,280,560,40,color);
    tft.fillRect(0,260,560,20,BLACK);
    tft.setCursor(65,150);
    tft.setTextSize(2);
    tft.setTextColor(WHITE);
    tft.print("Press to play");
    text_printed_paused++;
  }
  while(current_state==PAUSED && text_printed_paused==1) {
    TSPoint p= ts.getPoint();
    if (p.z>0) {
      current_state=RUNNING;
      text_printed_running=0;
    }
  }
  int i=485;
  int y=100;
  randomSeed(analogRead(6));
  int ratio= random(0,261);
  while (current_state==RUNNING && text_printed_running==0) {
    tft.reset();
    uint16_t ID= tft.readID();
    tft.begin(ID);
    tft.setRotation(1);
    tft.fillRect(0,0,560,260,back);
    color= tft.color565(r=190,g=190,b=124);
    tft.fillRect(0,280,560,40,color);
    tft.setCursor(5,295);
    tft.setTextSize(1);
    tft.setTextColor(BLACK);
    tft.print("Score: ");
    tft.setCursor(5,310);
    tft.print("Lives: ");
    tft.fillRect(0,260,560,20,BLACK);
    text_printed_running++;
  }
  while(current_state==RUNNING && text_printed_running==1) {
    if(digitalRead(button)==LOW) {
      y=y-10;
      delay(20);
    }
    drawObstacle(i,ratio);
    int ratio_top_refresh= (double(ratio)/double(260))*140;
    int ratio_bot_refresh= 185-int(ratio_top_refresh);
    tft.fillRect(50,y-4,35,4,back);
    tft.drawRGBBitmap(50,y,flappy,35,30);
    bool check_hit=detect_collision(i,ratio,y);
    tft.fillRect(50,y+30,35,5,back);
    tft.fillRect(i+77,0,25,ratio_top_refresh+1,back);
    tft.fillRect(i+77,int(ratio_top_refresh)+75,25,int(ratio_bot_refresh),back);
    //tft.fillRect(i-26,0,25,ratio_top_refresh,back);
    //tft.fillRect(i-26,int(ratio_top_refresh)+75,25,ratio_bot_refresh,back);
    i=i-10;
    y=y+5;
    not_gravity=0;
    if (y>=225) {
       tft.fillRect(50,y-5,35,35,back);
       lives= lives-1;
       score=0;
       current_state=PAUSED;
       text_printed_running=0;
       text_printed_paused=0;
       text_printed_gameover=0;
       y=100;
     }
    if (check_hit==true) {
       tft.fillRect(50,y-5,35,35,back);
       lives= lives-1;
       score=0;
       current_state=PAUSED;
       text_printed_running=0;
       text_printed_paused=0;
       text_printed_gameover=0;
       y=100;
    }
    if (i==-95) {
       i=485;
       randomSeed(analogRead(6));
       ratio=random(0,261);
       score=score+1;
       tft.setCursor(55,295);
       color=tft.color565(190,190,124);
       tft.setTextColor(BLACK,color);
       tft.setTextSize(1);
       tft.fillRect(52,280,428,15,color);
       tft.print(score);
       delay(10);
      }
    if (lives==0) {
      current_state=GAME_OVER;  
    }
    tft.setCursor(55,310);
    tft.setTextColor(BLUE,color);
    tft.setTextSize(1);
    tft.print(lives);
  }
  while (current_state==GAME_OVER && text_printed_gameover==0) {
  
    tft.fillScreen(BLACK);
    tft.setTextColor(WHITE);
    tft.setTextSize(2);
    tft.setCursor(100,75);
    tft.print("Game Over");
    tft.setCursor(80,110);
    tft.print("Click anywhere to retry");
    text_printed_gameover++;
  while (current_state==GAME_OVER && text_printed_gameover==1) {
    TSPoint u= ts.getPoint();
    if (u.z>0) {
      current_state=PAUSED;
      lives=3;
      text_printed_gameover=0;
      text_printed_paused=0;
    }
  }
  }
}
